## boards/shields/vik_ssd1306/Kconfig.shield
```kconfig
# Copyright (c) 2019 Linaro Limited
# SPDX-License-Identifier: Apache-2.0

config SHIELD_VIK_SSD1306_128X32
	def_bool $(shields_list_contains,vik_ssd1306_128x32)

config SHIELD_VIK_SSD1306_128X64
	def_bool $(shields_list_contains,vik_ssd1306_128x64)

config SHIELD_VIK_SH1106_128X64
	def_bool $(shields_list_contains,vik_sh1106_128x64)
```
